## app/scene_aware_speaker/Kconfig
```kconfig
#
# For a description of the syntax of this configuration file,
# see the file kconfig-language.txt in the NuttX tools repository.
#

config EXAMPLES_SCENE_AWARE_SPEAKER
	bool "AI Scene-Aware Smart Speaker"
	default n
	depends on AUDIO
	---help---
		Enable the AI scene-aware smart speaker application.
		Supports local voice wake word detection, scene recognition
		via TFLite Micro with sensor fusion, and smart home device
		control simulation on the Gemini-S1 (R528) board.

		All AI inference runs locally on device (no cloud dependency).

if EXAMPLES_SCENE_AWARE_SPEAKER

config SCENE_AWARE_SPEAKER_PRIORITY
	int "Speaker app task priority"
	default 100

config SCENE_AWARE_SPEAKER_STACKSIZE
	int "Speaker app stack size"
	default 8192

config SCENE_AWARE_SPEAKER_AUDIO_DEV_CAPTURE
	string "Audio capture device path"
	default "/dev/audio/pcm0c"

config SCENE_AWARE_SPEAKER_AUDIO_DEV_PLAYBACK
	string "Audio playback device path"
	default "/dev/audio/pcm0p"

config SCENE_AWARE_SPEAKER_SAMPLE_RATE
	int "Audio sample rate (Hz)"
	default 16000

config SCENE_AWARE_SPEAKER_CHANNELS
	int "Number of audio channels"
	default 1

config SCENE_AWARE_SPEAKER_FRAME_SIZE
	int "Audio frame size (bytes)"
	default 640

config SCENE_AWARE_SPEAKER_WAKE_WORD
	string "Wake word string"
	default "ni hao openvela"

config SCENE_AWARE_SPEAKER_SCENE_INTERVAL_MS
	int "Scene detection interval (ms)"
	default 2000

config SCENE_AWARE_SPEAKER_USE_SPEEXDSP
	bool "Use SpeexDSP for audio preprocessing"
	default y
	depends on AUDIOUTILS_SPEEXDSP
	---help---
		Enable SpeexDSP for noise reduction, AGC, and AEC.
		Requires CONFIG_AUDIOUTILS_SPEEXDSP to be enabled.

config SCENE_AWARE_SPEAKER_USE_TFLITE
	bool "Use TFLite Micro for scene detection"
	default n
	---help---
		Enable TFLite Micro for scene classification.
		When disabled, uses rule-based fallback detection.

config SCENE_AWARE_SPEAKER_USE_SENSORS
	bool "Use sensor fusion for scene detection"
	default y
	depends on SENSORS
	---help---
		Fuse sensor data (temperature, humidity, VOC, light)
		with audio features for improved scene detection accuracy.

config SCENE_AWARE_SPEAKER_MIHOME_SIM
	bool "Enable MiHome simulator for demo"
	default y
	---help---
		Simulate MiHome device control actions for demo purposes.
		Outputs control commands to serial log and LVGL UI.

endif
```

## app/smart_speaker/Kconfig
```kconfig
#
# For a description of the syntax of this configuration file,
# see the file kconfig-language.txt in the NuttX tools repository.
#

config EXAMPLES_SMART_SPEAKER
	bool "AI Scene-Aware Smart Speaker app"
	default n
	select AUDIO
	---help---
		AI scene-aware smart speaker: scene recognition, wakeup,
		AI Agent, pluggable IoT HAL, anomaly alert, LVGL UI.
		Target: Gemini-S1 (R528).

if EXAMPLES_SMART_SPEAKER

config SMART_SPEAKER_PRIORITY
	int "Speaker main task priority"
	default 100

config SMART_SPEAKER_STACKSIZE
	int "Speaker main task stack size"
	default 8192

config SMART_SPEAKER_AUDIO_DEV_CAPTURE
	string "Audio capture device path"
	default "/dev/audio/pcm0c"

config SMART_SPEAKER_AUDIO_DEV_PLAYBACK
	string "Audio playback device path"
	default "/dev/audio/pcm0p"

config SMART_SPEAKER_SAMPLE_RATE
	int "Audio sample rate (Hz)"
	default 16000

config SMART_SPEAKER_CHANNELS
	int "Number of audio channels"
	default 1

config SMART_SPEAKER_FRAME_MS
	int "Audio frame duration (ms)"
	default 20

config SMART_SPEAKER_IOT_MIOT
	bool "Use Mihome (米家) IoT backend (requires SDK + license)"
	default n
	---help---
		Enable Mihome backend. Off = local-simulation backend (full demo
		without Mihome account). 接口已按米家协议预留.

endif
```

## board/contest_board/Kconfig
```kconfig
#
# Contest 2026 team 092 - BK7258 devkit board
#
# AI场景感知智能音箱 - 新硬件平台适配
# 目标芯片: BK7258 (双核 ARM Cortex-M33 480MHz + AI加速器 + 音频DSP)
#

config ARCH_BOARD_CONTEST2026_092_BOARD
	bool "BK7258 devkit (contest2026_092)"
	select ARCH_ARM
	select ARCH_ARMV8M
	select ARCH_CORTEX_M33
	select ARCH_HAVE_CMNVIC
	select ARMV8M_HAVE_ICACHE
	select ARMV8M_HAVE_DCACHE
	---help---
		BK7258 devkit 开发板适配。
		芯片特性: 双核 Cortex-M33 @480MHz, 640KB SRAM + 16MB PSRAM,
		WiFi6 + BLE5.4, 硬件AI加速器, 音频DSP, LCD显示, 2D图形加速。
		本项目用于 2026 openvela AI硬件开发者大赛 AI场景感知智能音箱。

if ARCH_BOARD_CONTEST2026_092_BOARD

config ARCH_BOARD_CONTEST2026_092_BOARD_TAG
	string "Board tag"
	default "contest2026_092_board"

config ARCH_CHIP
	string
	default "bk7258"

config ARCH_CHIP_BK7258
	bool
	default y

# ===== Flash 存储配置 =====
config BK7258_FLASH
	bool "启用 BK7258 Flash 控制器"
	default y
	select MTD
	---help---
		BK7258 内置 Flash 控制器, 支持 XIP 与分区。
		分区方案: bootloader(256KB) + kernel(1MB) + rootfs(2MB)
		+ ai-models(2MB) + user-data(1MB)。

# ===== 内存布局配置 =====
config BK7258_FLASH_BASE
	hex "Flash 基地址"
	default 0x00000000
	---help---
		BK7258 内部 Flash 基地址。

config BK7258_FLASH_SIZE
	int "Flash 大小 (KB)"
	default 65536
	---help---
		Flash 总大小, 默认 64MB (含外挂 PSRAM 映射区域)。

config BK7258_SRAM_BASE
	hex "SRAM 基地址"
	default 0x20000000
	---help---
		BK7258 片内 SRAM 基地址。

config BK7258_SRAM_SIZE
	int "片内 SRAM 大小 (KB)"
	default 640
	---help---
		片内 SRAM 大小, 默认 640KB。

config BK7258_PSRAM_BASE
	hex "PSRAM 基地址"
	default 0x24000000
	---help---
		外挂 PSRAM 基地址 (16MB)。

config BK7258_PSRAM_SIZE
	int "PSRAM 大小 (KB)"
	default 16384
	---help---
		PSRAM 大小, 默认 16MB。

# ===== 主频配置 =====
config BK7258_SYSCLK
	int "系统主频 (MHz)"
	default 480
	range 24 480
	---help---
		Cortex-M33 主频, 最高 480MHz。

# ===== AI 加速器配置 =====
config BK7258_AI_ACCEL
	bool "启用 BK7258 硬件 AI 加速器"
	default y
	---help---
		BK7258 内置 AI 加速器, 支持 int8/int16 量化推理加速。
		本项目用于端侧声音场景识别推理。

config BK7258_AI_ACCEL_SRAM_SIZE
	int "AI 加速器专用 SRAM 大小 (KB)"
	default 128
	depends on BK7258_AI_ACCEL
	---help---
		AI 加速器权重缓存区大小。

# ===== 音频配置 =====
config BK7258_AUDIO_DSP
	bool "启用 BK7258 音频 DSP"
	default y
	---help---
		BK7258 集成专用音频 DSP, 支持降噪(NR)、回声消除(AEC)、
		自动增益(AGC), 适配智能音箱多麦阵列场景。

config BK7258_AUDIO_CHANNELS
	int "音频采集通道数"
	default 2
	range 1 4
	depends on BK7258_AUDIO_DSP
	---help---
		麦克风阵列通道数, 默认 2 通道(双麦)。

# ===== 网络配置 =====
config BK7258_WIFI6
	bool "启用 WiFi6"
	default y
	select ARCH_HAVE_NET
	select NETUTILS_WIRELESS
	---help---
		BK7258 支持 WiFi6 (802.11ax), 用于米家IoT云端接入。

config BK7258_BLE54
	bool "启用 BLE 5.4"
	default y
	---help---
		BK7258 支持蓝牙 5.4 双模, 用于设备配网与近场控制。

# ===== 显示配置 =====
config BK7258_LCD
	bool "启用 LCD 显示"
	default y
	select LVGL
	---help---
		BK7258 devkit 板载 LCD 触控屏, 用于场景状态可视化展示。

config BK7258_LCD_WIDTH
	int "LCD 宽度 (像素)"
	default 480
	depends on BK7258_LCD

config BK7258_LCD_HEIGHT
	int "LCD 高度 (像素)"
	default 320
	depends on BK7258_LCD

config BK7258_2D_ACCEL
	bool "启用 2D 图形硬件加速"
	default y
	depends on BK7258_LCD
	---help---
		BK7258 2D 图形加速器, 保障 LVGL UI 流畅运行。

# ===== 低功耗管理配置 =====
config BK7258_PM
	bool "启用低功耗管理"
	default y
	select PM
	---help---
		支持待机/睡眠模式, 夜间无操作时降低功耗。
		唤醒源: 语音唤醒 / 按键 / 定时器。

config BK7258_PM_WAKEUP_VOICE
	bool "语音唤醒"
	default y
	depends on BK7258_PM
	---help---
		睡眠模式下保持语音唤醒 (低功耗 DSP 持续拾音)。

# ===== 看门狗配置 =====
config BK7258_WDT
	bool "启用看门狗"
	default y
	select WATCHDOG
	---help---
		系统死锁时自动复位, 5秒超时。

config BK7258_WDT_TIMEOUT
	int "看门狗超时 (ms)"
	default 5000
	depends on BK7258_WDT

endif
```

## board/contest_board/configs/nsh/defconfig
```kconfig
#
# BK7258 devkit 完整配置 (L0-L5)
# 目标: 系统启动到 NSH 命令行 + 全部外设驱动
#
# 配置层级:
#   L0: 最小 NSH 基线 (时钟/串口/堆/NSH)
#   L1: 存储与文件系统 (Flash/MTD/littlefs)
#   L2: 网络 (WiFi6)
#   L3: 多媒体 (音频DSP/LCD/LVGL)
#   L4: AI 子系统 (AI加速器/TFLite Micro)
#   L5: 完整产品 (BLE/触控/低功耗)
#
# 注意: 初次移植时建议逐级启用, 每级编译验证后再启用下一级。
#

# ===== 架构与板级 =====
CONFIG_ARCH_BOARD_CONTEST2026_092_BOARD=y

# ===== NuttX 基础配置 =====
CONFIG_NUTTX_NEWLIB=y
CONFIG_LIBC_ARCH_ATOMIC=y
CONFIG_NFILE_DESCRIPTORS=16
CONFIG_NBLOCKING_IO=y

# ===== 时钟与定时器 =====
CONFIG_ARCH_TICK_FREQUENCY=1000
CONFIG_USEC_PER_TICK=1000
CONFIG_TIMER=y

# ===== RAM 分配 =====
CONFIG_MM_REGIONS=2
CONFIG_MM_HEAP.Bytes=1048576

# ===== 串口控制台 (NSH) =====
CONFIG_DEV_CONSOLE=y
CONFIG_UART_SERIALDRIVER=y
CONFIG_UART0_SERIAL_CONSOLE=y
CONFIG_UART0_RXBUFSIZE=256
CONFIG_UART0_TXBUFSIZE=256
CONFIG_UART0_BAUD=115200

# ===== NSH =====
CONFIG_NSH=y
CONFIG_NSH_READLINE=y
CONFIG_NSH_PROMPT_STRING="openvela> "
CONFIG_NSH_BUILTIN_APPS=y
CONFIG_NSH_DISABLE_MOUNT=n
CONFIG_NSH_DISABLE_ROMFS=n

# ===== 文件系统 =====
CONFIG_FS_PROCFS=y
CONFIG_MTD=y
CONFIG_MTD_PARTITION=y
CONFIG_MTD_SMART=y
CONFIG_FS_SMARTFS=y
CONFIG_SMARTFS_ERASEBLOCKSIZE=4096

# ===== 日志 =====
CONFIG_SYSLOG=y
CONFIG_SYSLOG_CHAR=y
CONFIG_SYSLOG_DEVPATH="/dev/console"

# ===== 内存信息命令 =====
CONFIG_FS_PROCFS_EXCLUDE_MEMINFO=n
CONFIG_FREE=y

# ===== 启动脚本 =====
CONFIG_INIT_ENTRYPOINT="nsh_main"

# ===== L1: 存储与文件系统 =====
CONFIG_BK7258_FLASH=y

# ===== L2: 网络 =====
CONFIG_BK7258_WIFI6=y
CONFIG_NET=y
CONFIG_NET_UDP=y
CONFIG_NET_TCP=y
CONFIG_NET_IPv4=y
CONFIG_NET_DHCP=y
CONFIG_NETUTILS_NETLIB=y

# ===== L3: 多媒体 =====
CONFIG_BK7258_AUDIO_DSP=y
CONFIG_BK7258_AUDIO_CHANNELS=2
CONFIG_BK7258_LCD=y
CONFIG_BK7258_LCD_WIDTH=480
CONFIG_BK7258_LCD_HEIGHT=320
CONFIG_BK7258_2D_ACCEL=y
CONFIG_AUDIO=y
CONFIG_LCD=y
CONFIG_LVGL=y
CONFIG_LV_COLOR_DEPTH=16

# ===== L4: AI 子系统 =====
CONFIG_BK7258_AI_ACCEL=y
CONFIG_BK7258_AI_ACCEL_SRAM_SIZE=128
CONFIG_TFLITE_MICRO=y

# ===== L5: 完整产品 =====
CONFIG_BK7258_BLE54=y
CONFIG_BK7258_PM=y
CONFIG_BK7258_PM_WAKEUP_VOICE=y
CONFIG_BK7258_WDT=y
CONFIG_BK7258_WDT_TIMEOUT=5000
CONFIG_PM=y
CONFIG_WATCHDOG=y
CONFIG_CRYPTO=y
```
